#include <Arduino.h>

#define PPM_PIN 6
#define CHANNEL_COUNT 8

// RadioLink T8FB BT observed PPM mapping.
// Printed CH numbers are 1-based, array indexes are 0-based.
constexpr uint8_t STEERING_CHANNEL_INDEX = 0;  // Printed CH1
constexpr uint8_t THROTTLE_CHANNEL_INDEX = 2;  // Printed CH3
constexpr uint8_t MODE_CHANNEL_INDEX = 4;      // Printed CH5

// Observed center calibration from rc_mix_test logs.
constexpr uint16_t STEERING_CENTER_US = 1489;
constexpr uint16_t THROTTLE_CENTER_US = 1535;
constexpr uint16_t RC_DEADBAND_US = 80;

constexpr uint16_t RC_MIN_VALID_US = 900;
constexpr uint16_t RC_MAX_VALID_US = 2100;
constexpr uint16_t RC_AUTO_SWITCH_ON_US = 1600;
constexpr uint32_t RC_TIMEOUT_MS = 500;

volatile uint32_t lastEdgeUs = 0;
volatile uint16_t ppmRaw[CHANNEL_COUNT] = {0};
volatile uint8_t ppmIndex = 0;
volatile uint32_t lastFrameMs = 0;
volatile bool frameSeen = false;

uint16_t ch[CHANNEL_COUNT] = {0};

void ppmISR() {
  uint32_t now = micros();
  uint32_t width = now - lastEdgeUs;
  lastEdgeUs = now;

  if (width > 4000) {
    ppmIndex = 0;
    frameSeen = true;
    lastFrameMs = millis();
    return;
  }

  if (ppmIndex < CHANNEL_COUNT) {
    ppmRaw[ppmIndex] = (uint16_t)width;
    ppmIndex++;
  }
}

void copyChannels() {
  noInterrupts();
  for (int i = 0; i < CHANNEL_COUNT; i++) {
    ch[i] = ppmRaw[i];
  }
  interrupts();
}

bool inRange(uint16_t us) {
  return us >= RC_MIN_VALID_US && us <= RC_MAX_VALID_US;
}

float normRcCentered(uint16_t us, uint16_t centerUs) {
  int delta = (int)us - (int)centerUs;

  if (abs(delta) <= RC_DEADBAND_US) {
    return 0.0f;
  }

  float denom = delta > 0 ? (2000.0f - centerUs) : (centerUs - 1000.0f);
  if (denom < 1.0f) {
    return 0.0f;
  }

  float x = (float)delta / denom;

  if (x > 1.0f) x = 1.0f;
  if (x < -1.0f) x = -1.0f;

  return x;
}

bool channelsValid(uint32_t ageMs) {
  if (!frameSeen) return false;
  if (ageMs > RC_TIMEOUT_MS) return false;

  uint16_t steer = ch[STEERING_CHANNEL_INDEX];
  uint16_t throttle = ch[THROTTLE_CHANNEL_INDEX];
  uint16_t mode = ch[MODE_CHANNEL_INDEX];

  return inRange(steer) && inRange(throttle) && inRange(mode);
}

void setup() {
  Serial.begin(115200);
  delay(1000);

  pinMode(PPM_PIN, INPUT_PULLUP);
  attachInterrupt(digitalPinToInterrupt(PPM_PIN), ppmISR, FALLING);

  Serial.println("OpenRB RC mix diagnostic test started.");
  Serial.println("No motor output is generated by this sketch.");
  Serial.println("Mapping: CH1=steering, CH3=throttle, CH5=manual/auto.");
  Serial.println("Calibration: steer center=1489, throttle center=1535, deadband=80us.");
  Serial.println("CH5 low/mid -> MANUAL, CH5 high -> AUTO.");
}

void loop() {
  copyChannels();

  uint32_t ageMs = millis() - lastFrameMs;
  bool valid = channelsValid(ageMs);

  uint16_t steerUs = ch[STEERING_CHANNEL_INDEX];
  uint16_t throttleUs = ch[THROTTLE_CHANNEL_INDEX];
  uint16_t modeUs = ch[MODE_CHANNEL_INDEX];

  float steering = valid ? normRcCentered(steerUs, STEERING_CENTER_US) : 0.0f;
  float throttle = valid ? normRcCentered(throttleUs, THROTTLE_CENTER_US) : 0.0f;

  float left = throttle - steering;
  float right = throttle + steering;

  if (left > 1.0f) left = 1.0f;
  if (left < -1.0f) left = -1.0f;
  if (right > 1.0f) right = 1.0f;
  if (right < -1.0f) right = -1.0f;

  int leftPulse = valid ? 1500 + (int)(left * 400.0f) : 1500;
  int rightPulse = valid ? 1500 + (int)(right * 400.0f) : 1500;

  Serial.print(valid ? "RC_OK" : "RC_BAD");
  Serial.print(" age_ms=");
  Serial.print(ageMs);

  Serial.print(" RAW:");
  for (int i = 0; i < CHANNEL_COUNT; i++) {
    Serial.print(" CH");
    Serial.print(i + 1);
    Serial.print("=");
    Serial.print(ch[i]);
  }

  Serial.print(" | selected steer_us=");
  Serial.print(steerUs);
  Serial.print(" throttle_us=");
  Serial.print(throttleUs);
  Serial.print(" mode_us=");
  Serial.print(modeUs);

  Serial.print(" mode=");
  Serial.print(modeUs > RC_AUTO_SWITCH_ON_US ? "AUTO" : "MANUAL");

  Serial.print(" steering=");
  Serial.print(steering, 2);
  Serial.print(" throttle=");
  Serial.print(throttle, 2);

  Serial.print(" virtual_left_us=");
  Serial.print(leftPulse);
  Serial.print(" virtual_right_us=");
  Serial.print(rightPulse);

  Serial.println();

  delay(300);
}
